## utility-os/Config.in
```kconfig
source "$BR2_EXTERNAL_CMPROVISION_PATH/package/cmp-rpi-boot-files/Config.in"
source "$BR2_EXTERNAL_CMPROVISION_PATH/package/cmp-rpi-utils/Config.in"
source "$BR2_EXTERNAL_CMPROVISION_PATH/package/cmp-usbboot-bootfiles/Config.in"
```

## utility-os/configs/cmprovision_defconfig
```kconfig
# cmprovision utility OS (docs/utility-os.md): what modules boot to be provisioned. tools/utility-os/build.sh sets
# BR2_LINUX_KERNEL_CUSTOM_TARBALL_LOCATION and BR2_GLOBAL_PATCH_DIR from utility-os/versions.env.
BR2_aarch64=y
BR2_cortex_a72=y
BR2_TOOLCHAIN_EXTERNAL=y
BR2_TOOLCHAIN_EXTERNAL_BOOTLIN=y
BR2_TOOLCHAIN_EXTERNAL_BOOTLIN_AARCH64_GLIBC_STABLE=y
BR2_CCACHE=y
BR2_DOWNLOAD_FORCE_CHECK_HASHES=y
BR2_TARGET_GENERIC_HOSTNAME="scriptexecute"
BR2_TARGET_GENERIC_ISSUE="cmprovision utility OS"
BR2_INIT_BUSYBOX=y
BR2_ROOTFS_DEVICE_CREATION_DYNAMIC_DEVTMPFS=y
BR2_TARGET_GENERIC_GETTY_PORT="tty1"
BR2_TARGET_GENERIC_GETTY_BAUDRATE_115200=y
BR2_SYSTEM_DHCP=""
BR2_ROOTFS_OVERLAY="$(BR2_EXTERNAL_CMPROVISION_PATH)/board/cmprovision/rootfs-overlay"
BR2_ROOTFS_POST_BUILD_SCRIPT="$(BR2_EXTERNAL_CMPROVISION_PATH)/board/cmprovision/post-build.sh"
BR2_ROOTFS_POST_IMAGE_SCRIPT="$(BR2_EXTERNAL_CMPROVISION_PATH)/board/cmprovision/post-image.sh"
BR2_LINUX_KERNEL=y
BR2_LINUX_KERNEL_CUSTOM_TARBALL=y
BR2_LINUX_KERNEL_CUSTOM_TARBALL_LOCATION="https://github.com/raspberrypi/linux/archive/UOS_LINUX_COMMIT/linux-UOS_LINUX_COMMIT.tar.gz"
BR2_LINUX_KERNEL_DEFCONFIG="bcm2711"
BR2_LINUX_KERNEL_CONFIG_FRAGMENT_FILES="$(BR2_EXTERNAL_CMPROVISION_PATH)/board/cmprovision/linux.fragment"
BR2_LINUX_KERNEL_LICENSE_FILES="COPYING LICENSES/preferred/GPL-2.0.cmprovision LICENSES/exceptions/Linux-syscall-note"
BR2_LINUX_KERNEL_IMAGEGZ=y
BR2_LINUX_KERNEL_DTS_SUPPORT=y
BR2_LINUX_KERNEL_INTREE_DTS_NAME="broadcom/bcm2711-rpi-cm4 broadcom/bcm2711-rpi-4-b broadcom/bcm2711-rpi-400"
BR2_LINUX_KERNEL_INTREE_DTSO_NAMES="overlays/spi-gpio40-45 overlays/dwc2"
BR2_LINUX_KERNEL_NEEDS_HOST_OPENSSL=y
BR2_PACKAGE_BUSYBOX_CONFIG_FRAGMENT_FILES="$(BR2_EXTERNAL_CMPROVISION_PATH)/board/cmprovision/busybox.fragment"
BR2_PACKAGE_E2FSPROGS=y
BR2_PACKAGE_E2FSPROGS_RESIZE2FS=y
BR2_PACKAGE_FLASHROM=y
BR2_PACKAGE_MMC_UTILS=y
BR2_PACKAGE_MMC_UTILS_ENABLE_DANGEROUS_COMMANDS=y
BR2_PACKAGE_PARTED=y
BR2_PACKAGE_UTIL_LINUX=y
BR2_PACKAGE_UTIL_LINUX_BINARIES=y
BR2_PACKAGE_UTIL_LINUX_IPCMK=y
BR2_PACKAGE_XZ=y
BR2_PACKAGE_LIBARCHIVE=y
BR2_PACKAGE_LIBARCHIVE_BSDTAR=y
BR2_PACKAGE_LIBSYSFS=y
BR2_PACKAGE_LIBCURL=y
BR2_PACKAGE_LIBCURL_CURL=y
BR2_PACKAGE_LIBCURL_VERBOSE=y
BR2_PACKAGE_LIBCURL_TLS_NONE=y
BR2_PACKAGE_DTC=y
# lldpd: the module names itself to its switch (S61lldpname); LLDP only, what the server reads on the switch is LLDP
BR2_PACKAGE_LLDPD=y
# BR2_PACKAGE_LLDPD_CDP is not set
# BR2_PACKAGE_LLDPD_FDP is not set
# BR2_PACKAGE_LLDPD_EDP is not set
# BR2_PACKAGE_LLDPD_SONMP is not set
# BR2_PACKAGE_LLDPD_LLDPMED is not set
# BR2_PACKAGE_LLDPD_DOT1 is not set
# BR2_PACKAGE_LLDPD_DOT3 is not set
# BR2_PACKAGE_LLDPD_CUSTOM_TLV is not set
BR2_PACKAGE_CMP_RPI_BOOT_FILES=y
BR2_PACKAGE_CMP_RPI_UTILS=y
BR2_PACKAGE_CMP_USBBOOT_BOOTFILES=y
BR2_PACKAGE_HOST_DOSFSTOOLS=y
BR2_PACKAGE_HOST_MTOOLS=y
BR2_TARGET_ROOTFS_CPIO=y
BR2_TARGET_ROOTFS_CPIO_XZ=y
# BR2_TARGET_ROOTFS_TAR is not set
```

## utility-os/package/cmp-rpi-boot-files/Config.in
```kconfig
config BR2_PACKAGE_CMP_RPI_BOOT_FILES
	bool "cmp-rpi-boot-files"
	help
	  start4.elf and fixup4.dat of a raspberrypi/firmware release
	  (UOS_FIRMWARE_TAG of utility-os/versions.env), for the TFTP
	  directory of the cmprovision utility OS.

	  https://github.com/raspberrypi/firmware
```

## utility-os/package/cmp-rpi-utils/Config.in
```kconfig
config BR2_PACKAGE_CMP_RPI_UTILS
	bool "cmp-rpi-utils"
	select BR2_PACKAGE_DTC # libfdt, for dtmerge
	help
	  vcgencmd, vcmailbox, dtoverlay, dtparam, dtmerge and pinctrl of
	  raspberrypi/utils (UOS_RPI_UTILS_COMMIT of
	  utility-os/versions.env), for the cmprovision utility OS.

	  https://github.com/raspberrypi/utils
```

## utility-os/package/cmp-usbboot-bootfiles/Config.in
```kconfig
config BR2_PACKAGE_CMP_USBBOOT_BOOTFILES
	bool "cmp-usbboot-bootfiles"
	help
	  bootfiles.bin of raspberrypi/usbboot (UOS_USBBOOT_TAG of
	  utility-os/versions.env): rpiboot takes the second stage of a
	  CM4 (2711/bootcode4.bin) from it.

	  https://github.com/raspberrypi/usbboot
```
